## main/Kconfig.projbuild
```kconfig
menu "JofTmode Configuration"

config JOFTMODE_I2C_SCL
    int "QMI8658 I2C SCL GPIO"
    range 0 48
    default 4
    help
        GPIO number used as SCL for the IMU I2C bus.

config JOFTMODE_I2C_SDA
    int "QMI8658 I2C SDA GPIO"
    range 0 48
    default 5
    help
        GPIO number used as SDA for the IMU I2C bus.

config JOFTMODE_I2C_FREQ_HZ
    int "QMI8658 I2C clock frequency (Hz)"
    range 10000 1000000
    default 100000
    help
        I2C master clock frequency for the IMU sensor.

config JOFTMODE_POWER_KEY_GPIO
    int "Power button GPIO"
    range 0 48
    default 46
    help
        GPIO number connected to the long-press power key.

config JOFTMODE_ENABLE_ML
    bool "Enable ML pipeline"
    default n
    help
        Enable the ML window/inference path for UI/SD logging.

endmenu
```
